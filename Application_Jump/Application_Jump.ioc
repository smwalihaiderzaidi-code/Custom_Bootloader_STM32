# file: Application_Jump.ioc
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FREERTOS.Tasks01=defaultTask,24,128,StartDefaultTask,Default,NULL,Static,defaultTaskBuffer,defaultTaskControlBlock;Task100ms,40,128,T_100msTask,Default,NULL,Static,Task100msBuffer,Task100msControlBlock;Task500ms,48,128,T_500msTask,Default,NULL,Static,Task500msBuffer,Task500msControlBlock
Mcu.Family=STM32G4
Mcu.Name=STM32G431C(6-8-B)Ux
Mcu.Package=UFQFPN48
NVIC.PriorityGroup=NVIC_PRIORITYGROUP_4
NVIC.TIM1_UP_TIM16_IRQn=true\:15\:0\:false\:false\:true\:false\:false\:true\:true
NVIC.TimeBase=TIM1_UP_TIM16_IRQn
NVIC.TimeBaseIP=TIM1
PB9.Signal=GPIO_Output
ProjectManager.HeapSize=0x200
ProjectManager.StackSize=0x400
ProjectManager.TargetToolchain=STM32CubeIDE
RCC.AHBFreq_Value=16000000
RCC.APB1Freq_Value=16000000
RCC.APB1TimFreq_Value=16000000
RCC.APB2Freq_Value=16000000
RCC.APB2TimFreq_Value=16000000
RCC.CortexFreq_Value=16000000
RCC.EXTERNAL_CLOCK_VALUE=12288000
RCC.HCLKFreq_Value=16000000
RCC.HSE_VALUE=8000000
RCC.HSI48_VALUE=48000000
RCC.HSI_VALUE=16000000
RCC.LSE_VALUE=32768
RCC.SYSCLKFreq_VALUE=16000000
RCC.USBFreq_Value=64000000
RCC.VCOOutputFreq_Value=128000000
VP_FREERTOS_VS_CMSIS_V2.Mode=CMSIS_V2
VP_SYS_VS_DBSignals.Mode=DisableDeadBatterySignals
VP_SYS_VS_tim1.Mode=TIM1
board=custom

// file: Core/Src/main.c
/* USER CODE BEGIN Header */
/**
  ******************************************************************************
  * @file           : main.c
  * @brief          : Main program body
  ******************************************************************************
  * @attention
  *
  * Copyright (c) 2026 STMicroelectronics.
  * All rights reserved.
  *
  * This software is licensed under terms that can be found in the LICENSE file
  * in the root directory of this software component.
  * If no LICENSE file comes with this software, it is provided AS-IS.
  *
  ******************************************************************************
  */
/* USER CODE END Header */
#include "main.h"
#include "cmsis_os.h"
#include "app_Header.h"
#include "app_ota.h"

typedef StaticTask_t osStaticThreadDef_t;

/* Definitions for defaultTask */
osThreadId_t defaultTaskHandle;
uint32_t defaultTaskBuffer[ 128 ];
osStaticThreadDef_t defaultTaskControlBlock;
const osThreadAttr_t defaultTask_attributes = {
  .name = "defaultTask",
  .stack_mem = &defaultTaskBuffer[0],
  .stack_size = sizeof(defaultTaskBuffer),
  .cb_mem = &defaultTaskControlBlock,
  .cb_size = sizeof(defaultTaskControlBlock),
  .priority = (osPriority_t) osPriorityNormal,
};
/* Definitions for Task100ms */
osThreadId_t Task100msHandle;
uint32_t Task100msBuffer[ 128 ];
osStaticThreadDef_t Task100msControlBlock;
const osThreadAttr_t Task100ms_attributes = {
  .name = "Task100ms",
  .stack_mem = &Task100msBuffer[0],
  .stack_size = sizeof(Task100msBuffer),
  .cb_mem = &Task100msControlBlock,
  .cb_size = sizeof(Task100msControlBlock),
  .priority = (osPriority_t) osPriorityHigh,
};
/* Definitions for Task500ms */
osThreadId_t Task500msHandle;
uint32_t Task500msBuffer[ 128 ];
osStaticThreadDef_t Task500msControlBlock;
const osThreadAttr_t Task500ms_attributes = {
  .name = "Task500ms",
  .stack_mem = &Task500msBuffer[0],
  .stack_size = sizeof(Task500msBuffer),
  .cb_mem = &Task500msControlBlock,
  .cb_size = sizeof(Task500msControlBlock),
  .priority = (osPriority_t) osPriorityRealtime,
};
/* USER CODE BEGIN PV */
volatile uint32_t applicationCounter = 12345U;
volatile uint32_t applicationStatus = 0U;

/* USER CODE END PV */

void SystemClock_Config(void);
static void MX_GPIO_Init(void);
void StartDefaultTask(void *argument);
void T_100msTask(void *argument);
void T_500msTask(void *argument);

/* USER CODE BEGIN 0 */

#define SRAM_START 0x20000000U
#define SRAM_END 0x20008000U
void FillEntireRam(void)
{
	volatile uint32_t *p = (uint32_t *)SRAM_START;
	while ((uint32_t)p < SRAM_END)
	{
		*p++ = 0xAAAAAAAAU;
	}
}

uint8_t enableOtaUpdate = 0;
uint8_t checkifEntered = 0;
/* USER CODE END 0 */

int main(void)
{

  /* MCU Configuration--------------------------------------------------------*/

  /* Reset of all peripherals, Initializes the Flash interface and the Systick. */
  HAL_Init();

  /* USER CODE BEGIN Init */
  App_Init();
  /* USER CODE END Init */

  /* Configure the system clock */
  SystemClock_Config();

  /* USER CODE BEGIN SysInit */
  //FillEntireRam();
  /* USER CODE END SysInit */

  /* Initialize all configured peripherals */
  MX_GPIO_Init();
  /* USER CODE BEGIN 2 */
//  for(int i=0; i<25;i++)
//  {
//	  gBootApi->TurnOn();
//	    HAL_Delay(50);
//	    gBootApi->TurnOff();
//	    HAL_Delay(50);
//  }
//  HAL_Delay(2000);
  /* USER CODE END 2 */

  /* Init scheduler */
  osKernelInitialize();

  /* Create the thread(s) */
  /* creation of defaultTask */
  defaultTaskHandle = osThreadNew(StartDefaultTask, NULL, &defaultTask_attributes);

  /* creation of Task100ms */
  Task100msHandle = osThreadNew(T_100msTask, NULL, &Task100ms_attributes);

  /* creation of Task500ms */
  Task500msHandle = osThreadNew(T_500msTask, NULL, &Task500ms_attributes);

  /* Start scheduler */
  osKernelStart();

  /* We should never get here as control is now taken by the scheduler */

  /* Infinite loop */
  while (1)
  {

  }
}

void SystemClock_Config(void)
{
  RCC_OscInitTypeDef RCC_OscInitStruct = {0};
  RCC_ClkInitTypeDef RCC_ClkInitStruct = {0};

  /** Configure the main internal regulator output voltage
  */
  HAL_PWREx_ControlVoltageScaling(PWR_REGULATOR_VOLTAGE_SCALE1);

  /** Initializes the RCC Oscillators according to the specified parameters
  * in the RCC_OscInitTypeDef structure.
  */
  RCC_OscInitStruct.OscillatorType = RCC_OSCILLATORTYPE_HSI;
  RCC_OscInitStruct.HSIState = RCC_HSI_ON;
  RCC_OscInitStruct.HSICalibrationValue = RCC_HSICALIBRATION_DEFAULT;
  RCC_OscInitStruct.PLL.PLLState = RCC_PLL_NONE;
  if (HAL_RCC_OscConfig(&RCC_OscInitStruct) != HAL_OK)
  {
    Error_Handler();
  }

  /** Initializes the CPU, AHB and APB buses clocks
  */
  RCC_ClkInitStruct.ClockType = RCC_CLOCKTYPE_HCLK|RCC_CLOCKTYPE_SYSCLK
                              |RCC_CLOCKTYPE_PCLK1|RCC_CLOCKTYPE_PCLK2;
  RCC_ClkInitStruct.SYSCLKSource = RCC_SYSCLKSOURCE_HSI;
  RCC_ClkInitStruct.AHBCLKDivider = RCC_SYSCLK_DIV1;
  RCC_ClkInitStruct.APB1CLKDivider = RCC_HCLK_DIV1;
  RCC_ClkInitStruct.APB2CLKDivider = RCC_HCLK_DIV1;

  if (HAL_RCC_ClockConfig(&RCC_ClkInitStruct, FLASH_LATENCY_0) != HAL_OK)
  {
    Error_Handler();
  }
}

static void MX_GPIO_Init(void)
{
  GPIO_InitTypeDef GPIO_InitStruct = {0};

  /* GPIO Ports Clock Enable */
  __HAL_RCC_GPIOB_CLK_ENABLE();

  /*Configure GPIO pin Output Level */
  HAL_GPIO_WritePin(GPIOB, GPIO_PIN_9, GPIO_PIN_RESET);

  /*Configure GPIO pin : PB9 */
  GPIO_InitStruct.Pin = GPIO_PIN_9;
  GPIO_InitStruct.Mode = GPIO_MODE_OUTPUT_PP;
  GPIO_InitStruct.Pull = GPIO_NOPULL;
  GPIO_InitStruct.Speed = GPIO_SPEED_FREQ_LOW;
  HAL_GPIO_Init(GPIOB, &GPIO_InitStruct);

}

/* USER CODE BEGIN 4 */
volatile uint32_t default_counter = 0;
volatile uint32_t counter_100ms = 0;
volatile uint32_t counter_500ms = 0;
/* USER CODE END 4 */

void StartDefaultTask(void *argument)
{
  /* USER CODE BEGIN 5 */
  /* Infinite loop */
  for(;;)
  {
	  gBootApi->TurnOn();
    osDelay(300);
    default_counter++;
    gBootApi->TurnOff();
    osDelay(300);
  }
  /* USER CODE END 5 */
}

void T_100msTask(void *argument)
{
  /* USER CODE BEGIN T_100msTask */
  /* Infinite loop */
  for(;;)
  {
	counter_100ms++;
    osDelay(100);
  }
  /* USER CODE END T_100msTask */
}

void T_500msTask(void *argument)
{
  /* USER CODE BEGIN T_500msTask */
  /* Infinite loop */
  for(;;)
  {
	counter_500ms++;
	if(enableOtaUpdate == 1)
	{
		checkifEntered = 1;
		enable_ota_request();
	}
    osDelay(500);

  }
  /* USER CODE END T_500msTask */
}

void HAL_TIM_PeriodElapsedCallback(TIM_HandleTypeDef *htim)
{
  if (htim->Instance == TIM1)
  {
    HAL_IncTick();
  }
}

void Error_Handler(void)
{
  __disable_irq();
  while (1)
  {
  }
}
